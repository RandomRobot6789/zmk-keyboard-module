## boards/shields/aluminum/Kconfig.shield
```kconfig
config SHIELD_ALUMINUM_LEFT
    def_bool $(shields_list_contains,aluminum_left)

config SHIELD_ALUMINUM_RIGHT
    def_bool $(shields_list_contains,aluminum_right)
```
