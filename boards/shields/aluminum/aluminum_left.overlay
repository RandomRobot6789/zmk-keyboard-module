#include "aluminum.dtsi"
#include <dt-bindings/zmk/hid_indicators.h>

&kscan0 {
    col-gpios
        = <&gpio1 2 GPIO_ACTIVE_HIGH>
        , <&gpio1 7 GPIO_ACTIVE_HIGH>
        , <&gpio0 9 GPIO_ACTIVE_HIGH>
        , <&gpio0 10 GPIO_ACTIVE_HIGH>
        , <&gpio1 11 GPIO_ACTIVE_HIGH>
        , <&gpio1 13 GPIO_ACTIVE_HIGH>
        , <&gpio1 15 GPIO_ACTIVE_HIGH>
        , <&gpio0 2 GPIO_ACTIVE_HIGH>
        , <&gpio0 29 GPIO_ACTIVE_HIGH>
        , <&gpio0 31 GPIO_ACTIVE_HIGH>
        ;
    row-gpios
        = <&gpio0 17 (GPIO_ACTIVE_HIGH | GPIO_PULL_DOWN)>
        , <&gpio0 20 (GPIO_ACTIVE_HIGH | GPIO_PULL_DOWN)>
        , <&gpio0 22 (GPIO_ACTIVE_HIGH | GPIO_PULL_DOWN)>
        , <&gpio0 24 (GPIO_ACTIVE_HIGH | GPIO_PULL_DOWN)>
        , <&gpio1 0 (GPIO_ACTIVE_HIGH | GPIO_PULL_DOWN)>
        , <&gpio0 11 (GPIO_ACTIVE_HIGH | GPIO_PULL_DOWN)>
        ;
};

&pinctrl {
    /* configuration for spi0 device, default state */
    spi0_default: spi0_default {
        /* node name is arbitrary */
        group1 {
            /* main role: configure P1.01 as SPI clock, P1.06 as SPI MOSI, don't use SPI MISO */
            psels = <NRF_PSEL(SPIM_SCK, 1, 1)>,
                    <NRF_PSEL(SPIM_MOSI, 1, 6)>;
        };
    };

    /* configuration for spi0 device, sleep state */
    spi0_sleep: spi0_sleep {
        group1 {
            /* main role: configure P1.01 as SPI clock, P1.06 as SPI MOSI, don't use SPI MISO */
            psels = <NRF_PSEL(SPIM_SCK, 1, 1)>,
                    <NRF_PSEL(SPIM_MOSI, 1, 6)>;
            low-power-enable;
        };
    };
};

&spi0 {
    compatible = "nordic,nrf-spim";
    pinctrl-0 = <&spi0_default>;
    pinctrl-1 = <&spi0_sleep>;
    pinctrl-names = "default", "sleep";
};

&spi0 {
    status = "okay";
    cs-gpios = <&gpio1 4 GPIO_ACTIVE_LOW>;
    shifter: 595@0 {
        compatible = "zmk,gpio-595";
        status = "okay";
        gpio-controller;
        spi-max-frequency = <125000>; //minimum supported. I used low frequency pins like a n00b. Sources say they are likely to cause bluetooth interference over 10 kHz. I'm trying it anyway; if the radio behavior is poor when LEDs are changing, blame this
        reg = <0>;
        #gpio-cells = <2>;
        ngpios = <8>;
    };
};

/ {
    leds {
        compatible = "gpio-leds";
        led_caps_lock: led_0 {
            gpios = <&shifter 0 GPIO_ACTIVE_HIGH>;
            status = "okay";
        };
        led_num_lock: led_1 {
            gpios = <&shifter 1 GPIO_ACTIVE_HIGH>;
            status = "okay";
        };
        led_scroll_lock: led_2 {
            gpios = <&shifter 2 GPIO_ACTIVE_HIGH>;
            status = "okay";
        };
        led_left_battery_full: led_3 {
            gpios = <&shifter 3 GPIO_ACTIVE_HIGH>;
            status = "okay";
        };
        led_left_low_battery: led_4 {
            gpios = <&shifter 4 GPIO_ACTIVE_HIGH>;
            status = "okay";
        };
    };

    hid_indicators {
        compatible = "zmk,indicator-leds";


        caps_lock_indicator: caps_lock {
            indicator = <HID_INDICATOR_CAPS_LOCK>;
            leds = <&led_caps_lock>;
        };
        num_lock_indicator: num_lock {
            indicator = <HID_INDICATOR_NUM_LOCK>;
            leds = <&led_num_lock>;
            active-brightness = <0>;
            inactive-brightness = <100>;
        };
        scroll_lock_indicator: scroll_lock {
            indicator = <HID_INDICATOR_SCROLL_LOCK>;
            leds = <&led_scroll_lock>;
        };
};
