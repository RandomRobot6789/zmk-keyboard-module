## boards/shields/aluminum/Kconfig.defconfig
```kconfig
if SHIELD_ALUMINUM_RIGHT

# Name must be less than 16 characters long!
config ZMK_KEYBOARD_NAME
    default "Aluminum"

config ZMK_SPLIT_ROLE_CENTRAL
    default y

endif

if SHIELD_ALUMINUM_LEFT || SHIELD_ALUMINUM_RIGHT

config ZMK_SPLIT
    default y

config SPI
    default y

config ZMK_SPLIT_PERIPHERAL_HID_INDICATORS
    default y

config ZMK_HID_INDICATORS
    default y

endif
```
